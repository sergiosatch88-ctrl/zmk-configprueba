#include <behaviors.dtsi>
#include <dt-bindings/zmk/keys.h>

/ {
    keymap {
        compatible = "zmk,keymap";

        test_layer {
            bindings = <
                &kp A    &kp B
            >;
        };
    };
};
